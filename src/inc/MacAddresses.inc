// Add you Teensy Mac Addresses here.
// ----------------------------------
//
// Per default the Automatic Orchestra expects 12 devices.
// The number of devices can be changed in Arrangement.h
// by setting a different value for the variable MEMBER_COUNT.
// TODO: add member count as parameter to Arrangement constructor.
//
// To see how to retrieve your Teensy Mac Address see the example
// RetrieveTeensyMacAddress
// 
// An example list of Mac Addresses looks like this:
// "04:E9:E5:01:16:E7",
// "04:E9:E5:01:16:C3",
// "04:E9:E5:00:FF:E4",
// "04:E9:E5:01:16:BD",
// "04:E9:E5:01:16:BE",
// "04:E9:E5:00:E2:08",
// "04:E9:E5:00:E1:BB",
// "04:E9:E5:01:16:9E",
// "04:E9:E5:01:16:A5",
// "04:E9:E5:01:16:7A",
// "04:E9:E5:02:41:7D",
// "04:E9:E5:01:16:AA"
